## config/config.in
```kconfig
#
# MicroK
#

mainmenu_name "MicroK"

#
# MicroK Kernel
#

source config/kernelconfig.in
```

## src/config/config.in
```kconfig
#
# MicroK
#

mainmenu_name "MicroK"

#
# MicroK Kernel
#

mainmenu_option next_comment
	comment 'Kernel & Hardware'
	source src/config/kernelconfig.in
endmenu

#
# MicroK Userland
#

source src/config/userconfig.in

#
# MicroK Images
#

source src/config/imageconfig.in
```
